## CMakeLists.txt
```
cmake_minimum_required(VERSION 3.20.0)
find_package(Zephyr REQUIRED HINTS $ENV{ZEPHYR_BASE})
project(adb_zephyr)
target_include_directories(app PRIVATE include)
target_sources(app PRIVATE
    src/main.c
    src/packet.c
    src/adb_shell.c
)
target_sources_ifdef(CONFIG_ADB_SYNC app PRIVATE src/adb_sync.c)
```

## Kconfig
```
# ADB protocol engine options (application side; the USB transport lives
# in the usbd_adb class driver and is configured by CONFIG_USBD_ADB_*).

menu "ADB protocol engine"

config ADB_SHELL_COUNT
	int "Number of concurrent 'adb shell' sessions"
	default 1
	range 1 4
	help
	  Each session statically allocates a Zephyr shell instance (its own
	  thread stack of CONFIG_SHELL_STACK_SIZE plus context and buffers),
	  so every extra session costs roughly 3 KB of RAM. An OPEN for a
	  shell beyond this limit is rejected with CLSE.

config ADB_SHELL_RX_BUF_SIZE
	int "Per-session shell input ring buffer size in bytes"
	default 256

config ADB_SYNC
	bool "ADB sync service (adb push / adb pull / adb ls)"
	default y
	depends on FILE_SYSTEM
	help
	  Serve the "sync:" service on top of the Zephyr VFS. One sync
	  session is handled at a time by a dedicated thread.

if ADB_SYNC

config ADB_SYNC_STACK_SIZE
	int "Sync service thread stack size"
	default 3072
	help
	  LittleFS metadata commits (file create, directory compaction)
	  are the deepest call chains on this thread.

config ADB_SYNC_THREAD_PRIORITY
	int "Sync service thread priority"
	default 7

endif # ADB_SYNC

endmenu

source "Kconfig.zephyr"
```

## prj.conf
```kconfig
CONFIG_CONSOLE=y
CONFIG_UART_CONSOLE=y
CONFIG_PRINTK=y

CONFIG_LOG=y
CONFIG_LOG_DEFAULT_LEVEL=3
# Increase log buffer to avoid dropped messages during burst loopback
CONFIG_LOG_BUFFER_SIZE=4096

# USB device stack (device_next)
CONFIG_USB_DEVICE_STACK_NEXT=y
CONFIG_USBD_ADB_CLASS=y
CONFIG_USBD_ADB_LOG_LEVEL_DBG=y

# System work queue stack: echo_work_fn calls usbd_adb_write() which
# iterates STRUCT_SECTION — needs a bit more stack than the default 1024.
CONFIG_SYSTEM_WORKQUEUE_STACK_SIZE=2048

# HWINFO for optional serial number descriptor
CONFIG_HWINFO=y
# Increase UDC buffer pool so we can allocate 4096 byte RX buffers
CONFIG_UDC_BUF_POOL_SIZE=16384
CONFIG_RING_BUFFER=y
CONFIG_SHELL=y
CONFIG_SHELL_BACKEND_DUMMY=n
# ls/cat/etc. for browsing the LittleFS mount from `adb shell`
CONFIG_FILE_SYSTEM_SHELL=y

# LittleFS on internal flash (storage_partition, 64 KB at 0xf0000)
CONFIG_FLASH=y
CONFIG_FLASH_MAP=y
CONFIG_FILE_SYSTEM=y
CONFIG_FILE_SYSTEM_LITTLEFS=y
# The SoC's on-chip flash node declares write-block-size = 128 (the MCXN23x
# ROM Flash API only programs in 128-byte pages, see nxp_mcxn23x_common.dtsi).
# read/prog size MUST be a multiple of that or every littlefs write silently
# fails with -EINVAL from FLASH_Program while lfs_format()'s own writes still
# limp through, making the mount look fine until the first real file write.
CONFIG_FS_LITTLEFS_READ_SIZE=128
CONFIG_FS_LITTLEFS_PROG_SIZE=128
CONFIG_FS_LITTLEFS_CACHE_SIZE=128
# lfs_format() needs ~3KB of stack; default main stack is only 1KB
CONFIG_MAIN_STACK_SIZE=4096
```

## app.overlay
```dts
/* FRDM-MCXN236 USB overlay for ADB bring-up.
 *
 * The FRDM-MCXN236 board DTS already defines zephyr_udc0 as an alias for
 * usb1 (the HS-capable EHCI controller). No child nodes are needed since
 * the ADB class uses USBD_DEFINE_CLASS (not DT-based instantiation).
 *
 * This file is intentionally minimal — the ADB class instance is registered
 * programmatically via usbd_register_class(), not via DTS.
 */

/* Nothing to add: zephyr_udc0 is already defined in the board DTS. */
```

## src/main.c
```c
/*
 * ADB-Zephyr: Minimal ADB CNXN Handshake
 */
#include <zephyr/kernel.h>
#include <zephyr/sys/printk.h>
#include <zephyr/sys/atomic.h>
#include <zephyr/sys/ring_buffer.h>
#include <zephyr/usb/usbd.h>
#include <zephyr/usb/class/usbd_adb.h>
#include <zephyr/drivers/usb/usb_buf.h>
#include <zephyr/logging/log.h>
#include <string.h>
#include <zephyr/sys/byteorder.h>
#include <zephyr/drivers/hwinfo.h>
#include <zephyr/fs/fs.h>
#include <zephyr/fs/littlefs.h>
#include <zephyr/storage/flash_map.h>

#include "adb.h"
#include "adb_shell.h"
#include "adb_sync.h"

LOG_MODULE_REGISTER(adb_main, LOG_LEVEL_DBG);

/* ── USB device context ── */
USBD_DEVICE_DEFINE(adb_usbd, DEVICE_DT_GET(DT_NODELABEL(zephyr_udc0)), 0x2FE3, 0xADB1);
USBD_DESC_LANG_DEFINE(adb_lang);
USBD_DESC_MANUFACTURER_DEFINE(adb_mfr, "Zephyr Project");
USBD_DESC_PRODUCT_DEFINE(adb_product, "Zephyr ADB");
USBD_DESC_CONFIG_DEFINE(adb_fs_cfg_desc, "FS Configuration");
USBD_DESC_CONFIG_DEFINE(adb_hs_cfg_desc, "HS Configuration");
USBD_CONFIGURATION_DEFINE(adb_fs_config, USB_SCD_SELF_POWERED, 250, &adb_fs_cfg_desc);
USBD_CONFIGURATION_DEFINE(adb_hs_config, USB_SCD_SELF_POWERED, 250, &adb_hs_cfg_desc);

/* ── LittleFS on internal flash (storage_partition, 64 KB) ── */
FS_LITTLEFS_DECLARE_DEFAULT_CONFIG(lfs_storage);
static struct fs_mount_t adb_lfs_mount = {
	.type       = FS_LITTLEFS,
	.fs_data    = &lfs_storage,
	.storage_dev = (void *)PARTITION_ID(storage_partition),
	.mnt_point  = "/lfs",
};

/* ── ADB State ── */
enum adb_state {
	ADB_DISCONNECTED,
	ADB_WAITING_CNXN,
	ADB_CONNECTED
};
static enum adb_state current_state = ADB_DISCONNECTED;

/* ── RX Stream Parser ── */
#define RX_RING_SIZE 8192
RING_BUF_DECLARE(rx_ring, RX_RING_SIZE);

#define RX_STREAM_MAX (ADB_HEADER_SIZE + ADB_MAX_PAYLOAD)
static uint8_t rx_stream[RX_STREAM_MAX];
static size_t rx_len = 0;

/* ── TX Buffer Pool ── */
#define TX_BUF_COUNT 2
USB_STATIC_BUF_DEFINE(tx_buf_0, RX_STREAM_MAX);
USB_STATIC_BUF_DEFINE(tx_buf_1, RX_STREAM_MAX);

static uint8_t *const tx_pool[TX_BUF_COUNT] = { tx_buf_0, tx_buf_1 };

USB_STATIC_BUF_DEFINE(tx_payload_0, ADB_MAX_PAYLOAD);
USB_STATIC_BUF_DEFINE(tx_payload_1, ADB_MAX_PAYLOAD);

static uint8_t *const tx_payload_pool[TX_BUF_COUNT] = { tx_payload_0, tx_payload_1 };

/*
 * Per-slot packet storage for adb_send_packet_sync().
 * NEVER put struct adb_packet on the stack — it is 4120 bytes and will
 * overflow the Zephyr main/workqueue stack silently. Each slot is protected
 * by tx_free_q: only the caller that holds idx can access tx_pkt_pool[idx].
 */
static struct adb_packet tx_pkt_pool[TX_BUF_COUNT];

K_MSGQ_DEFINE(tx_free_q, sizeof(uint8_t), TX_BUF_COUNT, 1);
K_MSGQ_DEFINE(tx_pending_q, sizeof(uint8_t), TX_BUF_COUNT, 1);

static ATOMIC_DEFINE(tx_active, 1);
static uint8_t tx_inflight_idx;
static size_t tx_inflight_len[TX_BUF_COUNT];

enum tx_phase {
	TX_PHASE_IDLE,
	TX_PHASE_HEADER,
	TX_PHASE_PAYLOAD
};
static enum tx_phase tx_current_phase = TX_PHASE_IDLE;

static struct adb_packet pkt_tx;
static struct adb_packet pkt_rx;

static void tx_work_fn(struct k_work *work);
K_WORK_DEFINE(tx_work, tx_work_fn);

static void adb_work_fn(struct k_work *work);
K_WORK_DEFINE(adb_work, adb_work_fn);

/* ── Implementation ── */

int adb_send_packet_sync(uint32_t cmd, uint32_t arg0, uint32_t arg1, const void *payload, size_t len, k_timeout_t timeout)
{
	uint8_t idx;
	if (k_msgq_get(&tx_free_q, &idx, timeout) != 0) {
		return -ENOMEM;
	}

	/* Use pre-allocated per-slot storage — never stack-allocate struct adb_packet
	 * (it is 4120 bytes and will silently overflow any Zephyr thread stack). */
	struct adb_packet *pkt = &tx_pkt_pool[idx];
	pkt->command = cmd;
	pkt->arg0 = arg0;
	pkt->arg1 = arg1;
	pkt->length = len;
	
	if (len > 0 && payload != NULL) {
		memcpy(pkt->payload, payload, len);
	}

	adb_packet_finalize(pkt);

	size_t encoded_len;
	if (adb_encode(pkt, tx_pool[idx], RX_STREAM_MAX, &encoded_len) != 0) {
		k_msgq_put(&tx_free_q, &idx, K_NO_WAIT);
		return -EINVAL;
	}
	if (pkt->length > 0) {
		memcpy(tx_payload_pool[idx], tx_pool[idx] + ADB_HEADER_SIZE, pkt->length);
	}

	tx_inflight_len[idx] = encoded_len;
	k_msgq_put(&tx_pending_q, &idx, K_NO_WAIT);
	k_work_submit(&tx_work);

	return 0;
}

static void handle_cnxn(struct adb_packet *rx)
{
	uint8_t idx;

	LOG_INF("Received CNXN: version=0x%08X maxdata=%u banner='%.*s'",
		rx->arg0, rx->arg1, rx->length, rx->payload);

	current_state = ADB_CONNECTED;

	if (k_msgq_get(&tx_free_q, &idx, K_NO_WAIT) != 0) {
		LOG_ERR("No free TX buffer for CNXN reply");
		return;
	}

	pkt_tx.command = ADB_CMD_CNXN;
	pkt_tx.arg0 = ADB_VERSION;
	pkt_tx.arg1 = ADB_MAX_PAYLOAD;

	const char *banner = "device::ro.product.name=Zephyr;ro.product.model=FRDM-MCXN236;ro.product.device=mcxn236;";
	pkt_tx.length = strlen(banner) + 1;
	memcpy(pkt_tx.payload, banner, pkt_tx.length);

	adb_packet_finalize(&pkt_tx);

	size_t encoded_len;
	if (adb_encode(&pkt_tx, tx_pool[idx], RX_STREAM_MAX, &encoded_len) != 0) {
		LOG_ERR("Failed to encode CNXN reply");
		k_msgq_put(&tx_free_q, &idx, K_NO_WAIT);
		return;
	}

	tx_inflight_len[idx] = encoded_len;
	k_msgq_put(&tx_pending_q, &idx, K_NO_WAIT);
	k_work_submit(&tx_work);
}

static void handle_packet(struct adb_packet *rx)
{
	switch (rx->command) {
	case ADB_CMD_CNXN:
		handle_cnxn(rx);
		break;
	case ADB_CMD_OPEN: {
		LOG_INF("Received OPEN request. Length=%u", rx->length);
		if (rx->length > 0 && rx->length <= sizeof(rx->payload)) {
			rx->payload[rx->length - 1] = 0;
		}
		if (strncmp((const char *)rx->payload, "sync:", 5) == 0) {
			adb_sync_handle_open(rx->arg0);
		} else {
			adb_shell_handle_open(rx->arg0, (const char *)rx->payload);
		}
		break;
	}
	/* Stream packets carry our local id in arg1; route them to its owner. */
	case ADB_CMD_WRTE:
		LOG_DBG("Received WRTE: local=%u remote=%u len=%u", rx->arg1, rx->arg0, rx->length);
		if (adb_sync_owns_stream(rx->arg1)) {
			adb_sync_handle_wrte(rx->arg1, rx->arg0, rx->payload, rx->length);
		} else {
			adb_shell_handle_wrte(rx->arg1, rx->arg0, rx->payload, rx->length);
		}
		break;
	case ADB_CMD_OKAY:
		LOG_DBG("Received OKAY: local=%u remote=%u", rx->arg1, rx->arg0);
		if (adb_sync_owns_stream(rx->arg1)) {
			adb_sync_handle_okay(rx->arg1, rx->arg0);
		} else {
			adb_shell_handle_okay(rx->arg1, rx->arg0);
		}
		break;
	case ADB_CMD_CLSE:
		LOG_INF("Received CLSE: local=%u remote=%u", rx->arg1, rx->arg0);
		if (adb_sync_owns_stream(rx->arg1)) {
			adb_sync_handle_clse(rx->arg1, rx->arg0);
		} else {
			adb_shell_handle_clse(rx->arg1, rx->arg0);
		}
		break;
	default:
		LOG_WRN("Unhandled ADB command: 0x%08X", rx->command);
		break;
	}
}

static void adb_work_fn(struct k_work *work)
{
	uint32_t to_read = RX_STREAM_MAX - rx_len;
	if (to_read > 0) {
		uint32_t read = ring_buf_get(&rx_ring, &rx_stream[rx_len], to_read);
		rx_len += read;
	}

	while (rx_len >= ADB_HEADER_SIZE) {
		uint32_t payload_len = (uint32_t)rx_stream[12] | ((uint32_t)rx_stream[13] << 8) |
				       ((uint32_t)rx_stream[14] << 16) | ((uint32_t)rx_stream[15] << 24);

		if (payload_len > ADB_MAX_PAYLOAD) {
			LOG_ERR("Payload len %u exceeds max %u. Dropping stream.", payload_len, ADB_MAX_PAYLOAD);
			rx_len = 0;
			ring_buf_reset(&rx_ring);
			current_state = ADB_WAITING_CNXN;
			adb_sync_reset();
			adb_shell_init();
			return;
		}

		uint32_t total_len = ADB_HEADER_SIZE + payload_len;
		if (rx_len < total_len) {
			break; /* Need more data */
		}

		int rc = adb_decode(&pkt_rx, rx_stream, total_len);
		if (rc == 0) {
			handle_packet(&pkt_rx);
		} else {
			LOG_ERR("ADB decode failure: err=%d, rx_len=%u, total_len=%u. Dropping stream.", rc, rx_len, total_len);
			rx_len = 0;
			ring_buf_reset(&rx_ring);
			current_state = ADB_WAITING_CNXN;
			adb_sync_reset();
			adb_shell_init();
			return;
		}

		rx_len -= total_len;
		if (rx_len > 0) {
			memmove(rx_stream, rx_stream + total_len, rx_len);
		}
	}
}

static void tx_work_fn(struct k_work *work)
{
	uint8_t idx;
	int ret;

	if (atomic_test_and_set_bit(tx_active, 0)) {
		return;
	}

	if (tx_current_phase == TX_PHASE_PAYLOAD) {
		idx = tx_inflight_idx;
		size_t payload_len = tx_inflight_len[idx] - ADB_HEADER_SIZE;
		LOG_DBG("TX payload: idx=%u len=%zu", idx, payload_len);
		ret = usbd_adb_write(tx_payload_pool[idx], payload_len);
		if (ret == 0) {
			return; /* sent() will clear flag and resubmit */
		}
		goto error;
	}

	if (k_msgq_get(&tx_pending_q, &idx, K_NO_WAIT) != 0) {
		atomic_clear_bit(tx_active, 0);
	tx_current_phase = TX_PHASE_IDLE;
		return;
	}

	tx_inflight_idx = idx;
	tx_current_phase = TX_PHASE_HEADER;

	LOG_DBG("TX start: idx=%u cmd=0x%08X len=%u", idx,
		sys_get_le32(tx_pool[idx] + 0), sys_get_le32(tx_pool[idx] + 12));

	ret = usbd_adb_write(tx_pool[idx], ADB_HEADER_SIZE);
	if (ret == 0) {
		return; /* sent() will clear flag and resubmit */
	}

error:
	LOG_WRN("TX write error %d", ret);
	k_msgq_put(&tx_free_q, &tx_inflight_idx, K_NO_WAIT);
	tx_current_phase = TX_PHASE_IDLE;
	atomic_clear_bit(tx_active, 0);
	k_work_submit(&tx_work);
}

/* ── USB Callbacks ── */

static void adb_connected_cb(struct usbd_class_data *c_data)
{
	LOG_INF("USB connected");
	current_state = ADB_WAITING_CNXN;
	adb_shell_init();
}

static void adb_disconnected_cb(struct usbd_class_data *c_data)
{
	uint8_t idx;

	LOG_INF("USB disconnected callback triggered!");
	current_state = ADB_DISCONNECTED;
	adb_sync_reset();

	atomic_clear_bit(tx_active, 0);
	tx_current_phase = TX_PHASE_IDLE;

	ring_buf_reset(&rx_ring);
	rx_len = 0;

	while (k_msgq_get(&tx_pending_q, &idx, K_NO_WAIT) == 0) {
		k_msgq_put(&tx_free_q, &idx, K_NO_WAIT);
	}
}

static void adb_received_cb(struct usbd_class_data *c_data, const uint8_t *data, size_t len)
{
	if (len > 0) {
		uint32_t written = ring_buf_put(&rx_ring, data, len);
		if (written < len) {
			LOG_WRN("RX ring buffer overflow");
		}
		k_work_submit(&adb_work);
	}
}

static void adb_sent_cb(struct usbd_class_data *c_data, const uint8_t *buf, size_t len, int err)
{
	const uint8_t *expected_buf = (tx_current_phase == TX_PHASE_HEADER) ?
				      tx_pool[tx_inflight_idx] :
				      tx_payload_pool[tx_inflight_idx];

	if (buf != expected_buf) {
		LOG_ERR("sent() buf mismatch: expected %p, got %p", expected_buf, buf);
		k_msgq_put(&tx_free_q, &tx_inflight_idx, K_NO_WAIT);
		tx_current_phase = TX_PHASE_IDLE;
		atomic_clear_bit(tx_active, 0);
		k_work_submit(&tx_work);
		return;
	}

	if (err != 0) {
		LOG_WRN("TX aborted: err=%d idx=%u phase=%d", err, tx_inflight_idx, tx_current_phase);
		k_msgq_put(&tx_free_q, &tx_inflight_idx, K_NO_WAIT);
		tx_current_phase = TX_PHASE_IDLE;
	} else {
		if (tx_current_phase == TX_PHASE_HEADER) {
			if (tx_inflight_len[tx_inflight_idx] > ADB_HEADER_SIZE) {
				tx_current_phase = TX_PHASE_PAYLOAD;
				/* Do not free buffer, payload is next */
			} else {
				k_msgq_put(&tx_free_q, &tx_inflight_idx, K_NO_WAIT);
				tx_current_phase = TX_PHASE_IDLE;
			}
		} else if (tx_current_phase == TX_PHASE_PAYLOAD) {
			LOG_DBG("TX complete: idx=%u", tx_inflight_idx);
			k_msgq_put(&tx_free_q, &tx_inflight_idx, K_NO_WAIT);
			tx_current_phase = TX_PHASE_IDLE;
		}
	}

	atomic_clear_bit(tx_active, 0);
	k_work_submit(&tx_work);
}

static const struct usbd_adb_ops adb_ops = {
	.connected    = adb_connected_cb,
	.disconnected = adb_disconnected_cb,
	.received     = adb_received_cb,
	.sent         = adb_sent_cb,
};

static void usbd_msg_cb(struct usbd_context *const ctx, const struct usbd_msg *msg)
{
	if (usbd_can_detect_vbus(ctx)) {
		if (msg->type == USBD_MSG_VBUS_READY) {
			usbd_enable(ctx);
		}
		if (msg->type == USBD_MSG_VBUS_REMOVED) {
			usbd_disable(ctx);
		}
	}
}

static int usb_init(void)
{
	struct usbd_context *ctx = &adb_usbd;

	usbd_add_descriptor(ctx, &adb_lang);
	usbd_add_descriptor(ctx, &adb_mfr);
	usbd_add_descriptor(ctx, &adb_product);

	usbd_adb_register(&adb_ops);

	usbd_add_configuration(ctx, USBD_SPEED_FS, &adb_fs_config);
	usbd_register_class(ctx, "adb_0", USBD_SPEED_FS, 1);

	if (usbd_caps_speed(ctx) == USBD_SPEED_HS) {
		usbd_add_configuration(ctx, USBD_SPEED_HS, &adb_hs_config);
		usbd_register_class(ctx, "adb_0", USBD_SPEED_HS, 1);
	}

	usbd_device_set_code_triple(ctx, USBD_SPEED_FS, 0, 0, 0);
	if (usbd_caps_speed(ctx) == USBD_SPEED_HS) {
		usbd_device_set_code_triple(ctx, USBD_SPEED_HS, 0, 0, 0);
	}

	usbd_init(ctx);
	usbd_msg_register_cb(ctx, usbd_msg_cb);

	/* Always enable USB. With VBUS detection, the normal path waits for a
	 * rising-edge interrupt on the VBUS pin. But after a soft reboot
	 * (e.g. west flash), the cable is already plugged in so no edge fires
	 * and the device never shows up on the host. Calling usbd_enable()
	 * unconditionally avoids this miss. */
	usbd_enable(ctx);

	return 0;
}

int main(void)
{
	for (uint8_t i = 0; i < TX_BUF_COUNT; i++) {
		k_msgq_put(&tx_free_q, &i, K_NO_WAIT);
	}

	printk("=== ADB-Zephyr Minimal CNXN ===\n");

	/* Mount LittleFS — auto-formats on first boot if flash is blank */
	int rc = fs_mount(&adb_lfs_mount);
	if (rc < 0) {
		printk("LittleFS mount failed (%d) — filesystem unavailable\n", rc);
	} else {
		printk("LittleFS mounted at /lfs (64 KB)\n");
	}

	if (usb_init()) {
		printk("USB init failed\n");
		return -1;
	}

	printk("USB ready. Waiting for host to send CNXN...\n");
	
	while (true) {
		k_sleep(K_SECONDS(5));
	}
	return 0;
}
```

## include/adb.h
```c
#ifndef ADB_H_
#define ADB_H_

#include <stdint.h>
#include <stddef.h>

#define ADB_MAX_PAYLOAD    4096u
#define ADB_HEADER_SIZE    24u   /* 6 x uint32_t, on the wire */

#define ADB_CMD_CNXN 0x4E584E43u
#define ADB_CMD_AUTH 0x48545541u
#define ADB_CMD_OPEN 0x4E45504Fu
#define ADB_CMD_OKAY 0x59414B4Fu
#define ADB_CMD_CLSE 0x45534C43u
#define ADB_CMD_WRTE 0x45545257u

#define ADB_VERSION        0x01000000u

/* In-memory representation. Instances of this struct are ~4.1KB —
 * NEVER declare one as a local variable. Use static/global storage only. */
struct adb_packet {
	uint32_t command;
	uint32_t arg0;
	uint32_t arg1;
	uint32_t length;
	uint32_t checksum;
	uint32_t magic;
	uint8_t  payload[ADB_MAX_PAYLOAD];
};

/* Sum of payload bytes mod 2^32 (legacy ADB "checksum"). */
uint32_t adb_checksum(const uint8_t *buf, uint32_t len);

/* Fill in checksum/magic for a packet whose command/arg0/arg1/length/payload
 * are already set. Safe to call multiple times. */
void adb_packet_finalize(struct adb_packet *pkt);

/*
 * Serialize pkt into out (caller-provided buffer, out_size bytes).
 * On success, *out_len = ADB_HEADER_SIZE + pkt->length.
 * Returns 0 on success, negative errno on failure:
 *   -EINVAL   bad pointer args
 *   -EMSGSIZE pkt->length > ADB_MAX_PAYLOAD
 *   -ENOSPC   out_size too small
 */
int adb_encode(const struct adb_packet *pkt, uint8_t *out, size_t out_size,
	       size_t *out_len);

/*
 * Parse a wire-format buffer into pkt. Validates magic and checksum.
 * Returns 0 on success, negative errno on failure:
 *   -EINVAL   bad pointer args
 *   -EMSGSIZE in_len too short for header or declared payload length
 *   -EPROTO   magic != ~command
 *   -EBADMSG  checksum mismatch
 */
int adb_decode(struct adb_packet *pkt, const uint8_t *in, size_t in_len);

#endif /* ADB_H_ */
```

## include/transport.h
```c
#ifndef ADB_TRANSPORT_H_
#define ADB_TRANSPORT_H_

#include "adb.h"

/* Called from adb_transport_process() when a complete, validated packet
 * has been received. pkt is a pointer to static internal storage —
 * copy out anything you need to keep before returning. */
typedef void (*adb_transport_rx_cb_t)(const struct adb_packet *pkt);

/* Initializes the dedicated ADB UART (lpuart0) and enables RX interrupts.
 * Returns 0 on success, -ENODEV if the UART device isn't ready. */
int adb_transport_init(adb_transport_rx_cb_t rx_cb);

/* Encodes pkt and writes it out over UART (blocking, poll-based TX).
 * Returns 0 on success, or the negative error from adb_encode(). */
int adb_transport_send(const struct adb_packet *pkt);

/* Drains any bytes collected by the RX ISR, feeds the packet parser,
 * and invokes the rx callback for each complete packet found.
 * Call this periodically (main loop or dedicated thread). Blocks up to
 * 50ms waiting for data; returns immediately if none arrives. */
void adb_transport_process(void);

#endif /* ADB_TRANSPORT_H_ */
```

## src/adb_shell.c
```c
#include <zephyr/kernel.h>
#include <zephyr/logging/log.h>
#include <zephyr/shell/shell.h>
#include <zephyr/sys/ring_buffer.h>
#include <string.h>

#include "adb.h"
#include "adb_shell.h"

LOG_MODULE_REGISTER(adb_shell, LOG_LEVEL_INF);

/* External function to send ADB packets (defined in main.c) */
extern int adb_send_packet_sync(uint32_t cmd, uint32_t arg0, uint32_t arg1, const void *payload, size_t len, k_timeout_t timeout);

struct adb_shell_session {
	bool in_use;
	uint32_t local_id;
	uint32_t remote_id;
	struct shell *sh;
	struct k_sem okay_sem;
	struct ring_buf rx_ring;
	uint8_t rx_buf[CONFIG_ADB_SHELL_RX_BUF_SIZE];
	shell_transport_handler_t shell_handler;
	void *shell_context;
	/* `exit` runs on this session's own shell thread; shell_uninit() can't
	 * tear down the thread it's running on, so the command just submits
	 * this and returns, and the system workqueue does the actual close. */
	struct k_work close_work;
};

static struct adb_shell_session shell_sessions[CONFIG_ADB_SHELL_COUNT];
static K_MUTEX_DEFINE(shell_lock);

static int adb_shell_transport_init(const struct shell_transport *transport,
				    const void *config,
				    shell_transport_handler_t evt_handler,
				    void *context)
{
	struct adb_shell_session *sess = (struct adb_shell_session *)transport->ctx;

	sess->shell_handler = evt_handler;
	sess->shell_context = context;
	ring_buf_reset(&sess->rx_ring);

	return 0;
}

static int adb_shell_transport_uninit(const struct shell_transport *transport)
{
	return 0;
}

static int adb_shell_transport_enable(const struct shell_transport *transport, bool blocking_tx)
{
	return 0;
}

static int adb_shell_transport_write(const struct shell_transport *transport,
				     const void *data, size_t length, size_t *cnt)
{
	struct adb_shell_session *sess = (struct adb_shell_session *)transport->ctx;

	if (!sess->in_use) {
		*cnt = 0;
		return -ENODEV;
	}

	/* Wait for OKAY from previous WRTE (host must ack before we send more).
	 * Use a bounded timeout: if the host drops OKAY (e.g. disconnected or
	 * CNXN not fully established) K_FOREVER would deadlock the shell thread. */
	if (k_sem_take(&sess->okay_sem, K_SECONDS(5)) != 0) {
		LOG_WRN("Timed out waiting for OKAY from host (sess local=%u)", sess->local_id);
		*cnt = 0;
		return -EIO;
	}

	/* Send WRTE to host. Use K_SECONDS(2) so a full TX queue doesn't
	 * stall the shell thread indefinitely. */
	int ret = adb_send_packet_sync(ADB_CMD_WRTE, sess->local_id, sess->remote_id, data, length, K_SECONDS(2));
	if (ret != 0) {
		LOG_WRN("TX enqueue failure for WRTE: err=%d", ret);
	}
	if (ret != 0) {
		k_sem_give(&sess->okay_sem);
	}
	if (ret != 0) {
		*cnt = 0;
		return ret;
	}

	*cnt = length;
	return 0;
}

static int adb_shell_transport_read(const struct shell_transport *transport,
				    void *data, size_t length, size_t *cnt)
{
	struct adb_shell_session *sess = (struct adb_shell_session *)transport->ctx;

	if (!sess->in_use) {
		*cnt = 0;
		return -ENODEV;
	}

	*cnt = ring_buf_get(&sess->rx_ring, data, length);
	return 0;
}

const struct shell_transport_api adb_shell_transport_api = {
	.init = adb_shell_transport_init,
	.uninit = adb_shell_transport_uninit,
	.enable = adb_shell_transport_enable,
	.write = adb_shell_transport_write,
	.read = adb_shell_transport_read
};

/* Define the shell transports and instances statically */
#define ADB_SHELL_NAME(n, _) &adb_shell_##n

#define ADB_SHELL_DEFINE_INST(n, _) \
	static const struct shell_transport shell_transport_adb_##n = { \
		.api = &adb_shell_transport_api, \
		.ctx = &shell_sessions[n], \
	}; \
	SHELL_DEFINE(adb_shell_##n, "adb:$ ", &shell_transport_adb_##n, 10, 10, SHELL_FLAG_OLF_CRLF);

LISTIFY(CONFIG_ADB_SHELL_COUNT, ADB_SHELL_DEFINE_INST, (;))

static const struct shell *const adb_shell_instances[] = {
	LISTIFY(CONFIG_ADB_SHELL_COUNT, ADB_SHELL_NAME, (,))
};

static void adb_shell_close_work_fn(struct k_work *work);

void adb_shell_init(void)
{
	for (size_t i = 0; i < CONFIG_ADB_SHELL_COUNT; i++) {
		shell_sessions[i].in_use = false;
		ring_buf_init(&shell_sessions[i].rx_ring, CONFIG_ADB_SHELL_RX_BUF_SIZE, shell_sessions[i].rx_buf);
		shell_sessions[i].sh = (struct shell *)adb_shell_instances[i];
		k_sem_init(&shell_sessions[i].okay_sem, 1, 1);
		k_work_init(&shell_sessions[i].close_work, adb_shell_close_work_fn);
	}
}

static void shell_uninit_completed(const struct shell *sh, int res)
{
	k_mutex_lock(&shell_lock, K_FOREVER);
	for (size_t i = 0; i < CONFIG_ADB_SHELL_COUNT; i++) {
		if (shell_sessions[i].sh == sh) {
			shell_sessions[i].in_use = false;
			LOG_INF("Shell slot %zu uninitialized fully.", i);
			break;
		}
	}
	k_mutex_unlock(&shell_lock);
}

void adb_shell_handle_open(uint32_t remote_id, const char *name)
{
	/* For now we only handle "shell:" or "shell:something". */
	LOG_INF("Processing OPEN service string: '%s'", name);
	if (strncmp(name, "shell:", 6) != 0) {
		LOG_WRN("Unsupported open request: %s", name);
		return;
	}

	k_mutex_lock(&shell_lock, K_FOREVER);
	struct adb_shell_session *sess = NULL;
	size_t slot = 0;
	for (size_t i = 0; i < CONFIG_ADB_SHELL_COUNT; i++) {
		if (!shell_sessions[i].in_use) {
			sess = &shell_sessions[i];
			slot = i;
			break;
		}
	}

	if (!sess) {
		k_mutex_unlock(&shell_lock);
		LOG_WRN("Shell session allocation FAILED for host %u (slots full or busy)", remote_id);
		/* Could send CLSE immediately, but host should just timeout if we don't OKAY */
		adb_send_packet_sync(ADB_CMD_CLSE, 0, remote_id, NULL, 0, K_NO_WAIT);
		return;
	}

	sess->in_use = true;
	sess->local_id = 0x54590000 | slot; /* 'TY' + slot */
	sess->remote_id = remote_id;
	ring_buf_reset(&sess->rx_ring);
	k_sem_reset(&sess->okay_sem);
	k_sem_give(&sess->okay_sem);
	k_mutex_unlock(&shell_lock);

	static const struct shell_backend_config_flags cfg_flags = SHELL_DEFAULT_BACKEND_CONFIG_FLAGS;
	int ret = shell_init(sess->sh, NULL, cfg_flags, false, LOG_LEVEL_NONE);
	/* -EINVAL: the shell was left initialized but stopped (see close paths
	 * above — we shell_stop() rather than shell_uninit() on close, so the
	 * thread and transport survive). -EALREADY: shell_init() sees ctx->tid
	 * already set for the same reason. Either way the instance is reusable;
	 * only a genuinely different error means shell_init() actually failed. */
	if (ret != 0 && ret != -EINVAL && ret != -EALREADY) {
		LOG_ERR("Failed to init shell (err %d)", ret);
		k_mutex_lock(&shell_lock, K_FOREVER);
		sess->in_use = false;
		k_mutex_unlock(&shell_lock);
		adb_send_packet_sync(ADB_CMD_CLSE, sess->local_id, remote_id, NULL, 0, K_NO_WAIT);
		return;
	}
	if (ret == -EINVAL || ret == -EALREADY) {
		LOG_INF("Shell already initialized (err %d). Starting it...", ret);
		shell_start(sess->sh);
	}

	LOG_INF("Mapped host %u to shell slot %zu (local_id %u), shell_init returned %d", remote_id, slot, sess->local_id, ret);
	adb_send_packet_sync(ADB_CMD_OKAY, sess->local_id, remote_id, NULL, 0, K_NO_WAIT);

	/* Feed a bare "\r" even when there's no extra command text: nothing
	 * draws the prompt on its own until the shell processes *something*
	 * (shell_start() itself doesn't print one — see the reopen path
	 * above), so without this the client shows nothing until the user's
	 * own first keypress happens to trigger it. */
	if (strlen(name) > 6) {
		ring_buf_put(&sess->rx_ring, (const uint8_t *)(name + 6), strlen(name + 6));
	}
	ring_buf_put(&sess->rx_ring, (const uint8_t *)"\r", 1);
	if (sess->shell_handler) {
		sess->shell_handler(SHELL_TRANSPORT_EVT_RX_RDY, sess->shell_context);
	}
}

void adb_shell_handle_wrte(uint32_t local_id, uint32_t remote_id, const uint8_t *data, size_t len)
{
	struct adb_shell_session *sess = NULL;

	k_mutex_lock(&shell_lock, K_FOREVER);
	for (size_t i = 0; i < CONFIG_ADB_SHELL_COUNT; i++) {
		if (shell_sessions[i].in_use && shell_sessions[i].local_id == local_id) {
			sess = &shell_sessions[i];
			break;
		}
	}
	k_mutex_unlock(&shell_lock);

	if (!sess) {
		LOG_WRN("WRTE to unknown local_id %u", local_id);
		adb_send_packet_sync(ADB_CMD_CLSE, local_id, remote_id, NULL, 0, K_NO_WAIT);
		return;
	}

	adb_send_packet_sync(ADB_CMD_OKAY, sess->local_id, remote_id, NULL, 0, K_NO_WAIT);

	if (len > 0) {
		uint32_t wrote = ring_buf_put(&sess->rx_ring, data, len);
		if (wrote < len) {
			LOG_WRN("Shell RX ring buffer full! Dropped %u bytes.", len - wrote);
		}
		if (sess->shell_handler) {
			sess->shell_handler(SHELL_TRANSPORT_EVT_RX_RDY, sess->shell_context);
		}
	}
}

/*
 * Device-initiated close, run on the system workqueue (never on the
 * session's own shell thread — see close_work's comment).
 *
 * Deliberately does NOT call shell_uninit(): its teardown is asynchronous
 * (shell_uninit() just posts SHELL_SIGNAL_KILL and returns; the shell's own
 * thread finishes the job and fires shell_uninit_completed() later), and
 * that races with this same stream being torn down — the shell thread can
 * end up wedged waiting on a transport OKAY that will never come because
 * the ADB stream is already gone. Since the shell instance and its thread
 * are static for the process lifetime anyway, and adb_shell_handle_open()
 * already handles reopening an instance that's still initialized (shell_init()
 * returns -EINVAL, so it just calls shell_start() again), the simplest safe
 * close is: free the slot and shell_stop() the instance (synchronous, and
 * safe to call from here — see its own comment about locking against a
 * command still finishing on the shell thread). That leaves it in
 * SHELL_STATE_INITIALIZED, so the next OPEN's shell_start() actually does
 * something instead of silently no-op'ing on an already-ACTIVE instance.
 */
static void adb_shell_close_work_fn(struct k_work *work)
{
	struct adb_shell_session *sess = CONTAINER_OF(work, struct adb_shell_session, close_work);

	k_mutex_lock(&shell_lock, K_FOREVER);
	bool active = sess->in_use;
	if (active) {
		sess->in_use = false;
		ring_buf_reset(&sess->rx_ring);
	}
	k_mutex_unlock(&shell_lock);

	if (!active) {
		return;
	}

	shell_stop(sess->sh);

	LOG_INF("Shell session exiting by command (local %u, remote %u)", sess->local_id,
		sess->remote_id);
	adb_send_packet_sync(ADB_CMD_CLSE, sess->local_id, sess->remote_id, NULL, 0, K_NO_WAIT);
}

static int cmd_exit(const struct shell *sh, size_t argc, char **argv)
{
	ARG_UNUSED(argc);
	ARG_UNUSED(argv);

	k_mutex_lock(&shell_lock, K_FOREVER);
	struct adb_shell_session *sess = NULL;
	for (size_t i = 0; i < CONFIG_ADB_SHELL_COUNT; i++) {
		if (shell_sessions[i].in_use && shell_sessions[i].sh == sh) {
			sess = &shell_sessions[i];
			break;
		}
	}
	k_mutex_unlock(&shell_lock);

	if (sess == NULL) {
		return -ENODEV;
	}

	/* Submit and return: freeing the slot from here (the shell's own
	 * thread) would race the shell's own post-command bookkeeping, so
	 * hand it to the system workqueue right after this command returns. */
	k_work_submit(&sess->close_work);
	return 0;
}
SHELL_CMD_REGISTER(exit, NULL, "Close this adb shell session", cmd_exit);

void adb_shell_handle_clse(uint32_t local_id, uint32_t remote_id)
{
	struct adb_shell_session *sess = NULL;

	k_mutex_lock(&shell_lock, K_FOREVER);
	for (size_t i = 0; i < CONFIG_ADB_SHELL_COUNT; i++) {
		if (shell_sessions[i].in_use && shell_sessions[i].local_id == local_id) {
			sess = &shell_sessions[i];
			shell_sessions[i].in_use = false;
			ring_buf_reset(&shell_sessions[i].rx_ring);
			break;
		}
	}
	k_mutex_unlock(&shell_lock);

	if (!sess) {
		return;
	}

	LOG_INF("Closing shell session (local %u, remote %u)", local_id, remote_id);

	/* Do NOT shell_uninit() here: see the comment on adb_shell_close_work_fn()
	 * — its teardown is async and racy against a stream that's already gone,
	 * and can wedge the shell thread. shell_stop() is synchronous and leaves
	 * the instance ready for shell_start() on the next OPEN. */
	shell_stop(sess->sh);
	adb_send_packet_sync(ADB_CMD_CLSE, sess->local_id, remote_id, NULL, 0, K_NO_WAIT);
}

void adb_shell_handle_okay(uint32_t local_id, uint32_t remote_id)
{
	struct adb_shell_session *sess = NULL;

	k_mutex_lock(&shell_lock, K_FOREVER);
	for (size_t i = 0; i < CONFIG_ADB_SHELL_COUNT; i++) {
		if (shell_sessions[i].in_use && shell_sessions[i].local_id == local_id) {
			sess = &shell_sessions[i];
			break;
		}
	}
	k_mutex_unlock(&shell_lock);

	if (sess) {
		k_sem_give(&sess->okay_sem);
	}
}

void adb_shell_reset(void)
{
	k_mutex_lock(&shell_lock, K_FOREVER);
	for (size_t i = 0; i < CONFIG_ADB_SHELL_COUNT; i++) {
		if (shell_sessions[i].in_use) {
			LOG_INF("Resetting shell session %zu due to host reconnect/disconnect", i);
			/* Unblock any shell thread blocked in write() waiting for OKAY. */
			k_sem_give(&shell_sessions[i].okay_sem);
			/*
			 * Force-clear in_use now so the next OPEN can claim this slot
			 * immediately on reconnect. shell_uninit() is async — without
			 * clearing here, shell_uninit_completed() may not have fired by
			 * the time the host re-sends OPEN, leaving all slots occupied.
			 */
			shell_sessions[i].in_use = false;
			ring_buf_reset(&shell_sessions[i].rx_ring);
			shell_uninit(shell_sessions[i].sh, shell_uninit_completed);
		}
	}
	k_mutex_unlock(&shell_lock);
}
```

## src/adb_shell.h
```c
#ifndef ADB_SHELL_H
#define ADB_SHELL_H

#include <stdint.h>
#include <stddef.h>

void adb_shell_init(void);
void adb_shell_handle_open(uint32_t remote_id, const char *name);
void adb_shell_handle_wrte(uint32_t local_id, uint32_t remote_id, const uint8_t *data, size_t len);
void adb_shell_handle_clse(uint32_t local_id, uint32_t remote_id);
void adb_shell_handle_okay(uint32_t local_id, uint32_t remote_id);
void adb_shell_reset(void);

#endif
```

## src/adb_sync.c
```c
/*
 * ADB sync service ("sync:") — adb push / pull / ls over the Zephyr VFS.
 *
 * The sync protocol is a byte stream carried inside ADB WRTE packets:
 * a request may span several WRTEs and one WRTE may carry several
 * requests (adb packs SEND+DATA+DONE for small files into one write), so
 * the parser reads from the stream rather than per packet.
 *
 * The protocol runs on its own thread because it must block: waiting for
 * the host's OKAY between our WRTEs and on flash I/O. The ADB RX work
 * item only copies the WRTE payload into sync_rx_buf and wakes the
 * thread. The thread OKAYs a WRTE only once it has fully consumed it,
 * which is the flow control that stops the host outrunning flash writes.
 *
 * Only one session is served at a time (the typical adb push/pull opens
 * exactly one), which keeps the RAM cost to two ADB_MAX_PAYLOAD buffers.
 */
#include <zephyr/kernel.h>
#include <zephyr/logging/log.h>
#include <zephyr/fs/fs.h>
#include <zephyr/sys/atomic.h>
#include <zephyr/sys/byteorder.h>
#include <zephyr/sys/util.h>
#include <string.h>

#include "adb.h"
#include "adb_sync.h"

LOG_MODULE_REGISTER(adb_sync, LOG_LEVEL_INF);

extern int adb_send_packet_sync(uint32_t cmd, uint32_t arg0, uint32_t arg1, const void *payload, size_t len, k_timeout_t timeout);

#define SYNC_LOCAL_ID_BASE 0x53590000u /* 'SY' + sequence */
#define SYNC_MAX_PATH      256
#define SYNC_HDR_SIZE      8           /* id + length */
#define SYNC_DATA_MAX      (ADB_MAX_PAYLOAD - SYNC_HDR_SIZE)

/* st_mode bits as the adb host expects them */
#define SYNC_S_IFDIR 0040000u
#define SYNC_S_IFREG 0100000u

enum {
	SYNC_ACTIVE,  /* session allocated (OPEN accepted, thread not yet done) */
	SYNC_RX_BUSY, /* sync_rx_buf holds a WRTE the thread has not drained */
	SYNC_ABORT,   /* host closed the stream or the link went down */
};

static atomic_t sync_flags;
static uint32_t sync_local_id;
static uint32_t sync_remote_id;
static uint16_t sync_id_seq;

static K_SEM_DEFINE(sync_open_sem, 0, 1);
static K_SEM_DEFINE(sync_rx_sem, 0, 1);
static K_SEM_DEFINE(sync_okay_sem, 0, 1);

static uint8_t sync_rx_buf[ADB_MAX_PAYLOAD];
static size_t sync_rx_len;
static size_t sync_rx_pos;
static uint8_t sync_tx_buf[ADB_MAX_PAYLOAD];

/* Thread-owned scratch; static to keep the thread stack small. */
static char sync_path[SYNC_MAX_PATH];
static struct fs_file_t sync_file;
static struct fs_dir_t sync_dir;
static struct fs_dirent sync_dirent;

static bool sync_aborted(void)
{
	return atomic_test_bit(&sync_flags, SYNC_ABORT);
}

static void sync_abort(void)
{
	atomic_set_bit(&sync_flags, SYNC_ABORT);
	k_sem_give(&sync_rx_sem);
	k_sem_give(&sync_okay_sem);
}

/* ── Stream input (thread side) ── */

/* Block until at least one unread byte of the current WRTE is available. */
static int sync_rx_wait(void)
{
	while (!sync_aborted()) {
		if (atomic_test_bit(&sync_flags, SYNC_RX_BUSY) && sync_rx_pos < sync_rx_len) {
			return 0;
		}
		k_sem_take(&sync_rx_sem, K_FOREVER);
	}
	return -ECONNRESET;
}

/* Mark n bytes consumed. A drained WRTE is OKAYed so the host sends the next. */
static void sync_rx_consume(size_t n)
{
	sync_rx_pos += n;
	if (sync_rx_pos == sync_rx_len) {
		atomic_clear_bit(&sync_flags, SYNC_RX_BUSY);
		if (sync_aborted()) {
			return;
		}
		adb_send_packet_sync(ADB_CMD_OKAY, sync_local_id, sync_remote_id, NULL, 0, K_SECONDS(2));
	}
}

static int sync_read(void *dst, size_t len)
{
	uint8_t *out = dst;

	while (len > 0) {
		int rc = sync_rx_wait();

		if (rc) {
			return rc;
		}
		size_t n = MIN(len, sync_rx_len - sync_rx_pos);

		memcpy(out, &sync_rx_buf[sync_rx_pos], n);
		out += n;
		len -= n;
		sync_rx_consume(n);
	}
	return 0;
}

/*
 * Stream len bytes into file, or discard them when file is NULL. A write
 * error is latched in *write_err and the rest is still drained, so the
 * stream stays in sync; the return value is only for link errors.
 */
static int sync_read_to_file(struct fs_file_t *file, size_t len, int *write_err)
{
	while (len > 0) {
		int rc = sync_rx_wait();

		if (rc) {
			return rc;
		}
		size_t n = MIN(len, sync_rx_len - sync_rx_pos);

		if (file != NULL && *write_err == 0) {
			ssize_t wr = fs_write(file, &sync_rx_buf[sync_rx_pos], n);

			if (wr < 0) {
				*write_err = (int)wr;
			} else if ((size_t)wr != n) {
				*write_err = -ENOSPC;
			}
		}
		len -= n;
		sync_rx_consume(n);
	}
	return 0;
}

/* Read a request path into sync_path. Returns -ENAMETOOLONG (stream still in sync) or a link error. */
static int sync_read_path(uint32_t len)
{
	int unused = 0;

	if (len >= SYNC_MAX_PATH) {
		int rc = sync_read_to_file(NULL, len, &unused);

		return rc ? rc : -ENAMETOOLONG;
	}

	int rc = sync_read(sync_path, len);

	if (rc) {
		return rc;
	}
	sync_path[len] = '\0';

	/* The VFS does not accept trailing slashes ("/lfs/" from adb push). */
	while (len > 1 && sync_path[len - 1] == '/') {
		sync_path[--len] = '\0';
	}
	return 0;
}

/* ── Stream output (thread side) ── */

/* Send sync_tx_buf[0..len) as one WRTE, after the host OKAYed our previous one. */
static int sync_send(size_t len)
{
	if (k_sem_take(&sync_okay_sem, K_SECONDS(5)) != 0) {
		LOG_WRN("Timed out waiting for OKAY from host");
		return -ETIMEDOUT;
	}
	if (sync_aborted()) {
		return -ECONNRESET;
	}
	return adb_send_packet_sync(ADB_CMD_WRTE, sync_local_id, sync_remote_id, sync_tx_buf, len, K_SECONDS(2));
}

/* id + length-prefixed message: OKAY, FAIL, and the DONE that ends a RECV. */
static int sync_send_status(uint32_t id, const char *msg)
{
	size_t len = (msg != NULL) ? MIN(strlen(msg), SYNC_DATA_MAX) : 0;

	sys_put_le32(id, sync_tx_buf);
	sys_put_le32(len, sync_tx_buf + 4);
	if (len > 0) {
		memcpy(sync_tx_buf + SYNC_HDR_SIZE, msg, len);
	}
	return sync_send(SYNC_HDR_SIZE + len);
}

static uint32_t sync_mode(const struct fs_dirent *entry)
{
	return (entry->type == FS_DIR_ENTRY_DIR) ? (SYNC_S_IFDIR | 0755) : (SYNC_S_IFREG | 0644);
}

/* ── Requests ── */

/* STAT: reply { id, mode, size, mtime }; all zero means "does not exist". */
static int sync_do_stat(uint32_t path_len)
{
	uint32_t mode = 0;
	uint32_t size = 0;
	int rc = sync_read_path(path_len);

	if (rc && rc != -ENAMETOOLONG) {
		return rc;
	}
	if (rc == 0) {
		if (strcmp(sync_path, "/") == 0) {
			mode = SYNC_S_IFDIR | 0755;
		} else if (fs_stat(sync_path, &sync_dirent) == 0) {
			mode = sync_mode(&sync_dirent);
			size = sync_dirent.size;
		}
	}
	LOG_INF("STAT %s -> mode %o size %u", sync_path, mode, size);

	sys_put_le32(SYNC_STAT, sync_tx_buf);
	sys_put_le32(mode, sync_tx_buf + 4);
	sys_put_le32(size, sync_tx_buf + 8);
	sys_put_le32(0, sync_tx_buf + 12); /* LittleFS keeps no mtime */
	return sync_send(16);
}

/* LIST: one { DENT, mode, size, mtime, namelen, name } per entry, then a DONE of the same shape. */
static int sync_do_list(uint32_t path_len)
{
	int rc = sync_read_path(path_len);

	if (rc && rc != -ENAMETOOLONG) {
		return rc;
	}
	LOG_INF("LIST %s", sync_path);

	fs_dir_t_init(&sync_dir);
	if (rc == 0 && fs_opendir(&sync_dir, sync_path) == 0) {
		while (fs_readdir(&sync_dir, &sync_dirent) == 0 && sync_dirent.name[0] != '\0') {
			size_t namelen = strlen(sync_dirent.name);

			sys_put_le32(SYNC_DENT, sync_tx_buf);
			sys_put_le32(sync_mode(&sync_dirent), sync_tx_buf + 4);
			sys_put_le32(sync_dirent.size, sync_tx_buf + 8);
			sys_put_le32(0, sync_tx_buf + 12);
			sys_put_le32(namelen, sync_tx_buf + 16);
			memcpy(sync_tx_buf + 20, sync_dirent.name, namelen);

			rc = sync_send(20 + namelen);
			if (rc) {
				fs_closedir(&sync_dir);
				return rc;
			}
		}
		fs_closedir(&sync_dir);
	}

	memset(sync_tx_buf, 0, 20);
	sys_put_le32(SYNC_DONE, sync_tx_buf);
	return sync_send(20);
}

/* RECV (pull): stream DATA chunks, then DONE, or FAIL. */
static int sync_do_recv(uint32_t path_len)
{
	int rc = sync_read_path(path_len);

	if (rc == -ENAMETOOLONG) {
		return sync_send_status(SYNC_FAIL, "path too long");
	}
	if (rc) {
		return rc;
	}
	LOG_INF("RECV %s", sync_path);

	fs_file_t_init(&sync_file);
	rc = fs_open(&sync_file, sync_path, FS_O_READ);
	if (rc) {
		return sync_send_status(SYNC_FAIL, (rc == -ENOENT) ? "No such file or directory" : "open failed");
	}

	for (;;) {
		ssize_t n = fs_read(&sync_file, sync_tx_buf + SYNC_HDR_SIZE, SYNC_DATA_MAX);

		if (n < 0) {
			fs_close(&sync_file);
			return sync_send_status(SYNC_FAIL, "read error");
		}
		if (n == 0) {
			break;
		}
		sys_put_le32(SYNC_DATA, sync_tx_buf);
		sys_put_le32((uint32_t)n, sync_tx_buf + 4);
		rc = sync_send(SYNC_HDR_SIZE + n);
		if (rc) {
			fs_close(&sync_file);
			return rc;
		}
	}
	fs_close(&sync_file);
	return sync_send_status(SYNC_DONE, NULL);
}

/* Create missing parent directories of path (like adbd does for push). */
static void sync_mkdirs(char *path)
{
	for (char *p = strchr(path + 1, '/'); p != NULL; p = strchr(p + 1, '/')) {
		*p = '\0';
		if (fs_stat(path, &sync_dirent) == -ENOENT) {
			fs_mkdir(path);
		}
		*p = '/';
	}
}

/* SEND (push): request is "path,mode", followed by DATA chunks and a DONE carrying mtime. */
static int sync_do_send(uint32_t spec_len)
{
	const char *err = NULL;
	bool file_open = false;
	int write_err = 0;
	uint8_t hdr[SYNC_HDR_SIZE];
	int rc = sync_read_path(spec_len);

	if (rc && rc != -ENAMETOOLONG) {
		return rc;
	}
	if (rc == -ENAMETOOLONG) {
		err = "path too long";
	} else {
		char *comma = strrchr(sync_path, ',');

		if (comma != NULL) {
			*comma = '\0';
		}
		LOG_INF("SEND %s", sync_path);

		sync_mkdirs(sync_path);
		fs_file_t_init(&sync_file);
		rc = fs_open(&sync_file, sync_path, FS_O_CREATE | FS_O_WRITE | FS_O_TRUNC);
		if (rc) {
			LOG_WRN("Cannot create %s (%d)", sync_path, rc);
			err = "cannot create file";
		} else {
			file_open = true;
		}
	}

	/* Drain to DONE even on error: the host sends the whole file before reading our reply. */
	for (;;) {
		rc = sync_read(hdr, sizeof(hdr));
		if (rc) {
			goto out;
		}
		uint32_t id = sys_get_le32(hdr);
		uint32_t arg = sys_get_le32(hdr + 4);

		if (id == SYNC_DONE) {
			break;
		}
		if (id != SYNC_DATA) {
			LOG_ERR("Unexpected sync id 0x%08x during SEND", id);
			rc = -EPROTO;
			goto out;
		}
		rc = sync_read_to_file(file_open ? &sync_file : NULL, arg, &write_err);
		if (rc) {
			goto out;
		}
	}

	if (file_open) {
		int close_rc = fs_close(&sync_file);

		file_open = false;
		if (write_err == 0) {
			write_err = close_rc;
		}
		if (write_err) {
			LOG_WRN("Write to %s failed (%d)", sync_path, write_err);
			fs_unlink(sync_path);
			err = (write_err == -ENOSPC) ? "No space left on device" : "write error";
		}
	}
	return err ? sync_send_status(SYNC_FAIL, err) : sync_send_status(SYNC_OKAY, NULL);

out:
	if (file_open) {
		fs_close(&sync_file);
		fs_unlink(sync_path);
	}
	return rc;
}

/* Serve requests until QUIT (returns 0) or an error that ends the session. */
static int sync_serve(void)
{
	uint8_t hdr[SYNC_HDR_SIZE];

	for (;;) {
		int rc = sync_read(hdr, sizeof(hdr));

		if (rc) {
			return rc;
		}
		uint32_t id = sys_get_le32(hdr);
		uint32_t len = sys_get_le32(hdr + 4);

		switch (id) {
		case SYNC_STAT:
			rc = sync_do_stat(len);
			break;
		case SYNC_LIST:
			rc = sync_do_list(len);
			break;
		case SYNC_RECV:
			rc = sync_do_recv(len);
			break;
		case SYNC_SEND:
			rc = sync_do_send(len);
			break;
		case SYNC_QUIT:
			return 0;
		default:
			/* v2 requests are only sent if we advertise stat_v2/sendrecv_v2. */
			LOG_WRN("Unsupported sync request 0x%08x", id);
			sync_send_status(SYNC_FAIL, "unsupported sync request");
			return -EPROTO;
		}
		if (rc) {
			return rc;
		}
	}
}

static void sync_thread_fn(void *p1, void *p2, void *p3)
{
	ARG_UNUSED(p1);
	ARG_UNUSED(p2);
	ARG_UNUSED(p3);

	for (;;) {
		k_sem_take(&sync_open_sem, K_FOREVER);

		int rc = sync_serve();

		LOG_INF("Sync session 0x%08x ended (%d)", sync_local_id, rc);
		if (!sync_aborted()) {
			adb_send_packet_sync(ADB_CMD_CLSE, sync_local_id, sync_remote_id, NULL, 0, K_SECONDS(2));
		}
		atomic_clear(&sync_flags);
	}
}

K_THREAD_DEFINE(adb_sync_tid, CONFIG_ADB_SYNC_STACK_SIZE, sync_thread_fn, NULL, NULL, NULL,
		CONFIG_ADB_SYNC_THREAD_PRIORITY, 0, 0);

/* ── ADB stream hooks (RX work item context; must not block) ── */

void adb_sync_handle_open(uint32_t remote_id)
{
	if (atomic_test_and_set_bit(&sync_flags, SYNC_ACTIVE)) {
		LOG_WRN("Sync busy, rejecting stream from host %u", remote_id);
		adb_send_packet_sync(ADB_CMD_CLSE, 0, remote_id, NULL, 0, K_NO_WAIT);
		return;
	}

	/* Fresh local id per session so a late CLSE for the old one can't hit the new one. */
	sync_local_id = SYNC_LOCAL_ID_BASE | sync_id_seq++;
	sync_remote_id = remote_id;
	sync_rx_len = 0;
	sync_rx_pos = 0;
	k_sem_reset(&sync_rx_sem);
	k_sem_reset(&sync_okay_sem);
	k_sem_give(&sync_okay_sem); /* our first WRTE may follow our OKAY directly */

	LOG_INF("Sync session 0x%08x opened for host %u", sync_local_id, remote_id);
	adb_send_packet_sync(ADB_CMD_OKAY, sync_local_id, remote_id, NULL, 0, K_NO_WAIT);
	k_sem_give(&sync_open_sem);
}

void adb_sync_handle_wrte(uint32_t local_id, uint32_t remote_id, const uint8_t *data, size_t len)
{
	ARG_UNUSED(remote_id);

	if (!adb_sync_owns_stream(local_id)) {
		return;
	}
	if (len == 0) {
		adb_send_packet_sync(ADB_CMD_OKAY, sync_local_id, sync_remote_id, NULL, 0, K_NO_WAIT);
		return;
	}
	if (len > sizeof(sync_rx_buf) || atomic_test_bit(&sync_flags, SYNC_RX_BUSY)) {
		/* Host ignored flow control; the stream can't be resynchronised. */
		LOG_ERR("Sync WRTE overrun (len %zu), closing stream", len);
		sync_abort();
		adb_send_packet_sync(ADB_CMD_CLSE, sync_local_id, sync_remote_id, NULL, 0, K_NO_WAIT);
		return;
	}

	/* Fill the buffer before publishing it: the thread only reads while RX_BUSY is set. */
	memcpy(sync_rx_buf, data, len);
	sync_rx_pos = 0;
	sync_rx_len = len;
	atomic_set_bit(&sync_flags, SYNC_RX_BUSY);
	k_sem_give(&sync_rx_sem);
}

void adb_sync_handle_okay(uint32_t local_id, uint32_t remote_id)
{
	ARG_UNUSED(remote_id);

	if (adb_sync_owns_stream(local_id)) {
		k_sem_give(&sync_okay_sem);
	}
}

void adb_sync_handle_clse(uint32_t local_id, uint32_t remote_id)
{
	ARG_UNUSED(remote_id);

	if (adb_sync_owns_stream(local_id)) {
		LOG_INF("Host closed sync session 0x%08x", local_id);
		sync_abort();
	}
}

bool adb_sync_owns_stream(uint32_t local_id)
{
	return atomic_test_bit(&sync_flags, SYNC_ACTIVE) && local_id == sync_local_id &&
	       !sync_aborted();
}

void adb_sync_reset(void)
{
	if (atomic_test_bit(&sync_flags, SYNC_ACTIVE)) {
		sync_abort();
	}
}
```

## src/adb_sync.h
```c
/*
 * ADB sync service ("sync:") — adb push / pull / ls over the Zephyr VFS.
 */
#ifndef ADB_SYNC_H
#define ADB_SYNC_H

#include <stdbool.h>
#include <stdint.h>
#include <stddef.h>

/* Sync message IDs: four ASCII chars read as a little-endian uint32. */
#define SYNC_ID(a, b, c, d) \
	((uint32_t)(a) | ((uint32_t)(b) << 8) | ((uint32_t)(c) << 16) | ((uint32_t)(d) << 24))

#define SYNC_STAT SYNC_ID('S', 'T', 'A', 'T')
#define SYNC_LIST SYNC_ID('L', 'I', 'S', 'T')
#define SYNC_SEND SYNC_ID('S', 'E', 'N', 'D')
#define SYNC_RECV SYNC_ID('R', 'E', 'C', 'V')
#define SYNC_DENT SYNC_ID('D', 'E', 'N', 'T')
#define SYNC_DONE SYNC_ID('D', 'O', 'N', 'E')
#define SYNC_DATA SYNC_ID('D', 'A', 'T', 'A')
#define SYNC_OKAY SYNC_ID('O', 'K', 'A', 'Y')
#define SYNC_FAIL SYNC_ID('F', 'A', 'I', 'L')
#define SYNC_QUIT SYNC_ID('Q', 'U', 'I', 'T')

#ifdef CONFIG_ADB_SYNC
/*
 * All handlers below are called from the ADB RX work item and never block.
 * The sync protocol itself runs on a dedicated thread.
 */
void adb_sync_handle_open(uint32_t remote_id);
void adb_sync_handle_wrte(uint32_t local_id, uint32_t remote_id, const uint8_t *data, size_t len);
void adb_sync_handle_clse(uint32_t local_id, uint32_t remote_id);
void adb_sync_handle_okay(uint32_t local_id, uint32_t remote_id);
bool adb_sync_owns_stream(uint32_t local_id);

/* Abort the active session (USB disconnect / stream resync). Safe from any context. */
void adb_sync_reset(void);
#else
#include <zephyr/kernel.h>
#include "adb.h"
/* Without the sync service no stream is ever owned, so only OPEN needs a reply. */
extern int adb_send_packet_sync(uint32_t cmd, uint32_t arg0, uint32_t arg1, const void *payload,
				size_t len, k_timeout_t timeout);
static inline void adb_sync_handle_open(uint32_t remote_id)
{
	adb_send_packet_sync(ADB_CMD_CLSE, 0, remote_id, NULL, 0, K_NO_WAIT);
}
static inline void adb_sync_handle_wrte(uint32_t l, uint32_t r, const uint8_t *d, size_t n) {}
static inline void adb_sync_handle_clse(uint32_t l, uint32_t r) {}
static inline void adb_sync_handle_okay(uint32_t l, uint32_t r) {}
static inline bool adb_sync_owns_stream(uint32_t l) { return false; }
static inline void adb_sync_reset(void) {}
#endif /* CONFIG_ADB_SYNC */

#endif
```
